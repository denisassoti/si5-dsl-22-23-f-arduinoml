// generated by ArduinoML

int BUTTON = 9;
int LED = 12;
int BUZZER = 11;

void setup() {
	pinMode(BUTTON, INPUT);
	pinMode(LED, OUTPUT);
	pinMode(BUZZER, OUTPUT);
}

int state = LOW; int prev = HIGH;
long time = 0; long debounce = 200;

void state_off() {
	digitalWrite(LED, LOW);
	digitalWrite(BUZZER, LOW);
	boolean guard =  millis() - time > debounce;
	if (digitalRead(BUTTON) == HIGH && guard) {
		time = millis(); state_buzz();
	} else {
		state_off();
	}
}

void state_buzz() {
	digitalWrite(LED, LOW);
	digitalWrite(BUZZER, HIGH);
	boolean guard =  millis() - time > debounce;
	if (digitalRead(BUTTON) == HIGH && guard) {
		time = millis(); state_led();
	} else {
		state_buzz();
	}
}

void state_led() {
	digitalWrite(LED, HIGH);
	digitalWrite(BUZZER, LOW);
	boolean guard =  millis() - time > debounce;
	if (digitalRead(BUTTON) == HIGH && guard) {
		time = millis(); state_off();
	} else {
		state_led();
	}
}

void loop() { state_off(); }
