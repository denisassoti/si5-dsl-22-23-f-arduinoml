// generated by ArduinoML

int BUTTON = 9;
int LED = 12;
char incomingByte;

void setup() {
	pinMode(BUTTON, INPUT);
	pinMode(LED, OUTPUT);
	Serial.begin(9600);
}

int state = LOW; int prev = HIGH;
long time = 0; long debounce = 200;

void state_off() {
	digitalWrite(LED, LOW);
	boolean guard =  millis() - time > debounce;
	if (Serial.available() > 0) {
		incomingByte = Serial.read();
	}
	if (((incomingByte == 'a' || incomingByte == 'A') || digitalRead(BUTTON) == HIGH) && guard) {
		time = millis(); state_on();
	} else {
		state_off();
	}
}

void state_on() {
	digitalWrite(LED, HIGH);
	boolean guard =  millis() - time > debounce;
	if (Serial.available() > 0) {
		incomingByte = Serial.read();
	}
	if ((incomingByte == 'e' || incomingByte == 'E') && guard) {
		time = millis(); state_off();
	} else {
		state_on();
	}
}

void loop() { state_off(); }
